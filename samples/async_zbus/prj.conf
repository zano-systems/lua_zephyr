## CMakeLists.txt
```
# SPDX-License-Identifier: Apache-2.0

cmake_minimum_required(VERSION 3.20.0)

set(ZEPHYR_EXTRA_MODULES "${CMAKE_CURRENT_SOURCE_DIR}/../../")

include(${ZEPHYR_EXTRA_MODULES}/luaz.cmake)
luaz_define_source_thread(src/listener.lua)
luaz_define_source_thread(src/plain.lua)

find_package(Zephyr REQUIRED HINTS $ENV{ZEPHYR_BASE})
project(async_zbus)

luaz_generate_threads()

target_sources(app PRIVATE src/publisher.c)
```

## sample.yaml
```
sample:
  name: Async scheduler with zbus
common:
  tags: lua_zephyr
  integration_platforms:
    - mps2/an385
  harness: console
tests:
  sample.lua_zephyr.async_zbus:
    harness_config:
      type: multi_line
      ordered: false
      regex:
        - "plain require ok=false"
        - "raw false .*channel 'chan_raw' has no message descriptor"
        - "idle nil EAGAIN"
        - "zephyr.msleep blocks every async task"
        - "fast got 12 dropped 0"
        - "slow first 1 later 8 dropped 3"
```

## prj.conf
```kconfig
CONFIG_LUA=y
CONFIG_LUA_ASYNC=y
CONFIG_LUA_LIB_BASE=y
CONFIG_LUA_LIB_ZBUS=y
CONFIG_LISTENER_LUA_THREAD_ASYNC=y

CONFIG_BOOT_BANNER=n
CONFIG_LOG=y
CONFIG_LOG_MODE_MINIMAL=y
CONFIG_ASSERT=y

CONFIG_SYS_HEAP_RUNTIME_STATS=y
CONFIG_INIT_STACKS=y
CONFIG_THREAD_STACK_INFO=y
CONFIG_SYS_HEAP_ARRAY_SIZE=2
CONFIG_THREAD_NAME=y
```

## src/publisher.c
```c
#include <zephyr/kernel.h>
#include <zephyr/zbus/zbus.h>
#include <luaz_msg_descr.h>

struct msg_tick {
	int32_t seq;
};

static const struct lua_msg_field_descr tick_fields[] = {
	LUA_MSG_FIELD(struct msg_tick, seq, LUA_MSG_TYPE_INT),
};

ZBUS_CHAN_DEFINE(chan_tick, struct msg_tick, NULL, LUA_ZBUS_MSG_DESCR(struct msg_tick, tick_fields),
		 ZBUS_OBSERVERS_EMPTY, ZBUS_MSG_INIT(0));

/* Never published: exercises await timeouts. */
ZBUS_CHAN_DEFINE(chan_idle, struct msg_tick, NULL, LUA_ZBUS_MSG_DESCR(struct msg_tick, tick_fields),
		 ZBUS_OBSERVERS_EMPTY, ZBUS_MSG_INIT(0));

/* No descriptor: chan:await must refuse it. */
ZBUS_CHAN_DEFINE(chan_raw, struct msg_tick, NULL, NULL, ZBUS_OBSERVERS_EMPTY, ZBUS_MSG_INIT(0));

/* Four spaced messages, then a burst of eight. */
static void publisher(void *p1, void *p2, void *p3)
{
	struct msg_tick msg;

	k_msleep(300);
	for (msg.seq = 1; msg.seq <= 12; msg.seq++) {
		zbus_chan_pub(&chan_tick, &msg, K_MSEC(100));
		if (msg.seq <= 4) {
			k_msleep(50);
		}
	}
}

K_THREAD_DEFINE(publisher_id, 1024, publisher, NULL, NULL, NULL, 5, 0, 0);
```
