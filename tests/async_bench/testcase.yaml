## tests/async_bench/testcase.yaml
```yaml
common:
  tags: lua_zephyr
  platform_allow:
    - mps2/an385
    - nrf52833dk/nrf52833
    - native_sim
    - native_sim/native/64
  integration_platforms:
    - mps2/an385
  harness: console
  timeout: 120
  harness_config:
    type: one_line
    regex:
      - "bench done: 0 failed"
tests:
  lua_zephyr.async_bench: {}
  lua_zephyr.async_bench.breakdown:
    extra_configs:
      - CONFIG_LUA_ASYNC_STATS=y
  lua_zephyr.async_bench.only_read:
    extra_configs:
      - CONFIG_BENCH_ONLY="read_async"
    harness_config:
      type: multi_line
      ordered: true
      regex:
        - "BENCH read_async .* gc=inc"
        - "BENCH read_async .* gc=gen"
        - "bench done: 0 failed"
```
