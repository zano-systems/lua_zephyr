## Kconfig.luaz
```kconfig
menu "Lua Zephyr"

config LUA
    bool "Lua support"
    select ZBUS
    select ZBUS_MSG_SUBSCRIBER
    select ZBUS_CHANNEL_NAME
    select ZBUS_OBSERVER_NAME
    help
      Enable Lua support. This is required for the Lua scripting engine.
      If you enable this option, you will be able to use Lua scripts and
      spawn Lua threads.

if LUA

    config LUA_REPL
    bool "Lua REPL support"
    select SHELL
    default n
    help
      Enable the Lua REPL (Read-Eval-Print Loop) support. This allows you to
      interactively run Lua commands via Zephyr's shell.

config LUA_REPL_LINE_SIZE
    int "Lua REPL line size"
    depends on LUA_REPL
    default 256
    help
      The maximum size of a line in the Lua REPL. This is the maximum number
      of characters that can be entered in a single line in the Lua REPL.

config LUA_THREAD_STACK_SIZE
    int "Lua thread stack size"
    default 2048
    help
      The stack size for Lua threads automatically created by Lua Zephyr.

config LUA_THREAD_HEAP_SIZE
  int "Lua thread heap size"
  default 32768
  help
    The heap size for Lua threads automatically created by Lua Zephyr.
    This is the size of the memory pool used by Lua for its internal
    memory management.

config LUA_THREAD_PRIORITY
  int "Lua thread priority"
  default 7
  help
    The priority of Lua threads automatically created by Lua Zephyr.
    Note that this is effectively the priority of the Lua thread and
    all will be created with this priority.

config LUA_LIBS_ALL
    bool "Preload all Lua standard libraries"
    help
      Preload all standard Lua libraries (string, table, math, coroutine,
      utf8, debug) and zbus into the Lua state. Disable to select
      individual libraries and reduce flash usage.

config LUA_LIB_BASE
    bool "Lua base library"
    default y if LUA_LIBS_ALL
    help
      Preload the Lua base library (type, tostring, tonumber, ipairs,
      pairs, error, pcall, select, next, rawget, rawset, etc.).

config LUA_LIB_STRING
    bool "Lua string library"
    default y if LUA_LIBS_ALL
    help
      Preload the Lua string library (string.format, string.sub, etc.).

config LUA_LIB_TABLE
    bool "Lua table library"
    default y if LUA_LIBS_ALL
    help
      Preload the Lua table library (table.insert, table.sort, etc.).

config LUA_LIB_MATH
    bool "Lua math library"
    default y if LUA_LIBS_ALL
    help
      Preload the Lua math library (math.sin, math.floor, etc.).

config LUA_LIB_COROUTINE
    bool "Lua coroutine library"
    default y if LUA_LIBS_ALL
    help
      Preload the Lua coroutine library.

config LUA_LIB_UTF8
    bool "Lua utf8 library"
    default y if LUA_LIBS_ALL
    help
      Preload the Lua utf8 library.

config LUA_LIB_DEBUG
    bool "Lua debug library"
    default y if LUA_LIBS_ALL
    help
      Preload the Lua debug library.

config LUA_LIB_ZBUS
    bool "Lua zbus library"
    default y if LUA_LIBS_ALL
    help
      Include zbus bindings as zephyr.zbus subtable.

config LUA_PRECOMPILE
    bool "Pre-compile Lua scripts to bytecode at build time"
    help
      Compiles .lua scripts to stripped bytecode during the build using a
      host-built luac. Reduces target heap usage by skipping the parse phase.

config LUA_PRECOMPILE_ONLY
    bool "Exclude Lua parser from target build (bytecode only)"
    depends on LUA_PRECOMPILE
    depends on !LUA_REPL
    help
      Removes lparser.c, llex.c, and lcode.c from the target binary.
      Saves ~15-20KB flash. All scripts must be pre-compiled.

config LUA_EXTRA_OPTIMIZATIONS
    bool "Extra heap optimizations for bytecode-only builds [EXPERIMENTAL]"
    depends on LUA_PRECOMPILE_ONLY
    select EXPERIMENTAL
    help
      Reduce Lua internal data structure sizes for lower heap usage.
      Saves ~636 bytes per lua_newstate on 32-bit targets by reducing
      the string table initial size (128->64) and string cache (53x2->11x1).

config LUA_ASYNC
    bool "Cooperative async scheduler (zephyr.async)"
    select ZBUS_RUNTIME_OBSERVERS
    select POLL
    help
      The zephyr.async library: cooperative tasks (spawn, sleep, yield,
      join, cancel) and chan:await. Enable it per thread with
      CONFIG_<NAME>_LUA_THREAD_ASYNC; the script body becomes the first
      task.

if LUA_ASYNC

config LUA_ASYNC_MAX_TASKS
    int "Maximum live tasks per async thread (including task-0)"
    range 1 256
    default 8
    help
      Each task slot costs 40 bytes of scheduler state on 32-bit targets,
      plus the task's coroutine while it is live.

config LUA_ASYNC_MAX_CHANNELS
    int "Maximum channels one async thread can await"
    range 1 256
    default 8
    help
      Each channel record costs 24 bytes of scheduler state on 32-bit
      targets. Each awaited channel also uses one zbus runtime observer
      node: from the kernel heap with ZBUS_RUNTIME_OBSERVERS_NODE_ALLOC_DYNAMIC
      (the default), or from CONFIG_ZBUS_RUNTIME_OBSERVERS_NODE_POOL_SIZE
      with ZBUS_RUNTIME_OBSERVERS_NODE_ALLOC_STATIC.

config LUA_ASYNC_MAX_READERS
    int "Default awaited (task, channel) pairs per async thread"
    range 0 8192
    default 0
    help
      A task holds one reader per channel it has awaited, until it ends.
      Readers come from a per-thread k_mem_slab of 16-byte blocks (24 on
      64-bit targets); await raises when it is empty. 0 means
      2 x LUA_ASYNC_MAX_TASKS, capped at LUA_ASYNC_MAX_TASKS x
      LUA_ASYNC_MAX_CHANNELS (every possible pair). Per-thread override:
      CONFIG_<NAME>_LUA_ASYNC_MAX_READERS.

config LUA_ASYNC_MAX_LOCK_WAITS
    int "Channel locks the idle scheduler waits on at once"
    range 1 32
    default 4
    help
      While idle, the scheduler sleeps on its subscriber and on the locks
      that pub_async/read_async calls wait for, one k_poll event each
      (about 20 bytes of stack). With more distinct locks than this, it
      wakes every tick to recheck them.

config LUA_ASYNC_CHAN_QUEUE_DEPTH
    int "Default broadcast ring depth per awaited channel"
    range 1 1024
    default 4
    help
      Recent messages kept per awaited channel. A task that falls further
      behind loses the oldest ones (see chan:dropped()). Override with
      chan:queue_depth(n).

config LUA_ASYNC_MAX_DRAIN
    int "Maximum messages taken from zbus per scheduler pass"
    range 1 1024
    default 16

config LUA_ASYNC_THREAD_STACK_SIZE
    int "Default stack size for async Lua threads"
    default 4096
    help
      Default stack size of threads with CONFIG_<NAME>_LUA_THREAD_ASYNC=y.

endif # LUA_ASYNC

config LUA_FS
    bool "Lua filesystem support"
    depends on FILE_SYSTEM
    help
      Enable filesystem support for Lua scripts. Provides fs.dofile,
      fs.loadfile, and fs.list to Lua scripts, and replaces the standard
      dofile/loadfile globals with FS-backed versions.
      The application is responsible for mounting the filesystem before
      Lua threads start.

config LUA_FS_MOUNT_POINT
    string "Lua FS mount point"
    depends on LUA_FS
    default "/lfs"
    help
      Mount point prefix used by the Lua fs library for relative paths.

config LUA_FS_MAX_FILE_SIZE
    int "Maximum Lua script file size (bytes)"
    depends on LUA_FS
    default 4096
    help
      Maximum size of a Lua script file that can be loaded from the filesystem.

config LUA_FS_SHELL
    bool "Lua filesystem shell commands"
    depends on LUA_FS
    select SHELL
    help
      Enable shell commands for managing Lua scripts on the filesystem:
      lua_fs list, cat, write, delete, run, stat.

module = LUA_ZEPHYR
module-str = luaz
source "subsys/logging/Kconfig.template.log_config"

osource "$(KCONFIG_BINARY_DIR)/Kconfig.lua_thread.*"

endif

endmenu

choice LIBC_IMPLEMENTATION
    default NEWLIB_LIBC if LUA
endchoice

config COMMON_LIBC_REMOVE
    default n if LUA
```

## samples/async/sample.yaml
```yaml
sample:
  name: Async scheduler (coroutine-first)
common:
  tags: lua_zephyr
  integration_platforms:
    - mps2/an385
  harness: console
  harness_config:
    type: multi_line
    ordered: true
    regex:
      - "loop start"
      - "tasks spawned"
      - "alpha round 1"
      - "beta round 1"
      - "gamma round 1"
      - "alpha round 2"
      - "beta round 2"
      - "gamma round 2"
      - "alpha round 3"
      - "beta round 3"
      - "alpha done"
      - "gamma round 3"
      - "beta done"
      - "gamma done"
      - "heap:\\s+\\d{4,5}\\s+\\d+\\s+\\d+\\s+\\d+%"
      - "stack:\\s+\\d+\\s+\\d+\\s+\\d+\\s+\\d+%"
tests:
  sample.lua_zephyr.async: {}
  sample.lua_zephyr.async.precompile_only:
    extra_args:
      - ASYNC_BYTECODE=1
    extra_configs:
      - CONFIG_LUA_PRECOMPILE=y
      - CONFIG_LUA_PRECOMPILE_ONLY=y
```

## samples/async_files/sample.yaml
```yaml
sample:
  name: Async tasks from separate files
common:
  tags: lua_zephyr
  integration_platforms:
    - mps2/an385
  harness: console
  harness_config:
    type: multi_line
    ordered: false
    regex:
      - "^alpha done"
      - "^beta done"
      - "^gamma done"
      - "^delta done"
      - "^epsilon done"
      - "^zeta done"
      - "^eta done"
      - "^theta done"
      - "^iota done"
      - "^kappa done"
      - "^lambda done"
      - "^mu done"
      - "^nu done"
      - "^xi done"
      - "^omicron done"
      - "^pi done"
      - "heap:\\s+\\d{4,5}\\s+\\d+\\s+\\d+\\s+\\d+%"
tests:
  sample.lua_zephyr.async_files: {}
  sample.lua_zephyr.async_files.precompile_only:
    extra_args:
      - ASYNC_BYTECODE=1
    extra_configs:
      - CONFIG_LUA_PRECOMPILE=y
      - CONFIG_LUA_PRECOMPILE_ONLY=y
```

## tests/async/testcase.yaml
```yaml
common:
  tags: lua_zephyr
  platform_allow: native_sim
  integration_platforms:
    - native_sim
  harness: console
tests:
  lua_zephyr.async:
    harness_config:
      type: one_line
      regex:
        - "async tests: 78 passed, 0 failed, 7 skipped"
  lua_zephyr.async.limits:
    extra_configs:
      - CONFIG_LUA_ASYNC_MAX_CHANNELS=2
      - CONFIG_LUA_ASYNC_MAX_DRAIN=2
    harness_config:
      type: one_line
      regex:
        - "async tests: 3 passed, 0 failed, 82 skipped"
  lua_zephyr.async.watch_fail:
    extra_configs:
      - CONFIG_ZBUS_RUNTIME_OBSERVERS_NODE_ALLOC_STATIC=y
      - CONFIG_ZBUS_RUNTIME_OBSERVERS_NODE_POOL_SIZE=1
      - CONFIG_ZBUS_ASSERT_MOCK=y
    harness_config:
      type: one_line
      regex:
        - "async tests: 3 passed, 0 failed, 82 skipped"
  lua_zephyr.async.readers:
    extra_configs:
      - CONFIG_LUA_ASYNC_MAX_READERS=2
    harness_config:
      type: one_line
      regex:
        - "async tests: 2 passed, 0 failed, 83 skipped"
  lua_zephyr.async.many:
    extra_configs:
      - CONFIG_LUA_ASYNC_MAX_TASKS=64
    harness_config:
      type: one_line
      regex:
        - "async tests: 2 passed, 0 failed, 83 skipped"
  lua_zephyr.async.lock_waits:
    extra_configs:
      - CONFIG_LUA_ASYNC_MAX_LOCK_WAITS=1
    harness_config:
      type: one_line
      regex:
        - "async tests: 2 passed, 0 failed, 83 skipped"
```

## tests/async_names/testcase.yaml
```yaml
common:
  tags: lua_zephyr
  platform_allow: native_sim
  integration_platforms:
    - native_sim
  harness: console
tests:
  lua_zephyr.async_names.basenames:
    harness_config:
      type: multi_line
      ordered: false
      regex:
        - "^a/foo ran"
        - "^b/foo ran"
        - "^my-file ran"
  lua_zephyr.async_names.fs_path:
    extra_args:
      - ASYNC_NAMES_FS=1
    extra_configs:
      - CONFIG_FILE_SYSTEM=y
      - CONFIG_LUA_FS=y
    harness_config:
      type: one_line
      regex:
        - 'cannot open /lfs/dir "q"/back\\slash\.lua'
```
